## config/west.yml
```yaml
manifest:
  remotes:
    - name: zmkfirmware
      url-base: https://github.com/zmkfirmware
    - name: jlw # You can name this whatever you like; just make sure the "remote" below matches.
      url-base: https://github.com/josh-l-wang
  projects:
    - name: zmk
      remote: zmkfirmware
      revision: 73ca365530bc79d03dc64d89adc03b4ccbeeb14e
      import: app/west.yml
    # Add the name of the repository as a project.
    - name: zmk-config-jlw
      remote: jlw
      revision: main # This is the name of the branch you want to use.
  self:
    path: config
```
